//--------------------------------------- code chạy ssd1306-----------------------------------------------

#include <stdio.h>
#include <stdlib.h>
#include <string.h>
#include <math.h>
#include "freertos/FreeRTOS.h"
#include "freertos/task.h"
#include "esp_log.h"
#include "driver/gpio.h"
#include "ssd1306.h"
#include "input_iot.h"
#include "esp_timer.h"
#include "esp_spi_flash.h"
#include <I2SOutput.h>
#include <DACOutput.h>
#include <minimp3.h>
#include <sys/unistd.h>
#include <sys/stat.h>
#include "esp_err.h"
#include "esp_vfs_fat.h"
#include "driver/sdspi_host.h"
#include "driver/spi_common.h"
#include "sdmmc_cmd.h"
#include "sdkconfig.h"
#include <dirent.h>
#include <iostream>
#include <string>
#ifdef CONFIG_IDF_TARGET_ESP32
#include "driver/sdmmc_host.h"
#endif

// static const char *TAG = "example";

#define MOUNT_POINT "/sdcard"

#define MINIMP3_IMPLEMENTATION
#define MINIMP3_ONLY_MP3
#define MINIMP3_NO_STDIO
#define GPIO_BUTTON GPIO_NUM_0
#define USE_SPI_MODE

// ESP32-S2 doesn't have an SD Host peripheral, always use SPI:
#ifdef CONFIG_IDF_TARGET_ESP32S2

#ifndef USE_SPI_MODE
#define USE_SPI_MODE
#endif // USE_SPI_MODE
// on ESP32-S2, DMA channel must be the same as host id
#define SPI_DMA_CHAN    host.slot
#endif //CONFIG_IDF_TARGET_ESP32S2

// DMA channel to be used by the SPI peripheral
#ifndef SPI_DMA_CHAN
#define SPI_DMA_CHAN    1
#endif //SPI_DMA_CHAN

// When testing SD and SPI modes, keep in mind that once the card has been
// initialized in SPI mode, it can not be reinitialized in SD mode without
// toggling power to the card.

#ifdef USE_SPI_MODE
// Pin mapping when using SPI mode.
// With this mapping, SD card can be used both in SPI and 1-line SD mode.
// Note that a pull-up on CS line is required in SD mode.
#define PIN_NUM_MISO 2
#define PIN_NUM_MOSI 15
#define PIN_NUM_CLK  14
#define PIN_NUM_CS   GPIO_NUM_13
#endif //USE_SPI_MODE

#include <string>

using namespace std;
#define VOLUME_CONTROL ADC1_CHANNEL_7
#define TAG "SSD1306"

#define IMAGES 8
#define dvdIMAGES 8


extern "C"
{
  void app_main();
}

uint8_t play_icon[] = {
	0x70, 0x00, 0x7c, 0x00, 0x4e, 0x00, 0x43, 0x80, 0x40, 0xe0, 0x40, 0x38, 0x40, 0x1c, 0x40, 0x06, 
	0x40, 0x0e, 0x40, 0x18, 0x40, 0x70, 0x40, 0xc0, 0x43, 0x80, 0x4e, 0x00, 0x78, 0x00, 0x70, 0x00
};
uint8_t pause_icon[] = {
0x0c, 0x30, 0x1e, 0x78, 0x1e, 0x78, 0x1e, 0x78, 0x1e, 0x78, 0x1e, 0x78, 0x1e, 0x78, 0x1e, 0x78, 
	0x1e, 0x78, 0x1e, 0x78, 0x1e, 0x78, 0x1e, 0x78, 0x1e, 0x78, 0x1e, 0x78, 0x1e, 0x78, 0x0c, 0x30
};
uint8_t next_icon[] = {
	0x00, 0x00, 0x41, 0x00, 0xe1, 0xc0, 0xf1, 0xe0, 0xf9, 0xf0, 0xff, 0xf8, 0xff, 0xfe, 0xff, 0xff, 
	0xff, 0xff, 0xff, 0xfe, 0xff, 0xf8, 0xf9, 0xf0, 0xf1, 0xe0, 0xe1, 0xc0, 0x41, 0x00, 0x00, 0x00
};
uint8_t prev_icon[] = {
	0x00, 0x00, 0x00, 0x00, 0x01, 0x83, 0x03, 0x87, 0x0f, 0x9f, 0x1f, 0xbf, 0x7f, 0xff, 0xff, 0xff, 
	0xff, 0xff, 0x7f, 0xff, 0x1f, 0xbf, 0x0f, 0x9f, 0x03, 0x87, 0x01, 0x83, 0x00, 0x00, 0x00, 0x00
};

// DVD image
uint8_t dvd_icon[dvdIMAGES][392] = {
	{
		// 'dvd1' 60x60px

	0x00, 0x00, 0x01, 0xff, 0x80, 0x00, 0x00, 0x00, 0x00, 0x1f, 0xff, 0xf8, 0x00, 0x00, 0x00, 0x00, 
	0x7e, 0x00, 0x7e, 0x00, 0x00, 0x00, 0x03, 0xe0, 0x00, 0x07, 0xc0, 0x00, 0x00, 0x07, 0x80, 0x00, 
	0x01, 0xe0, 0x00, 0x00, 0x1e, 0x00, 0x00, 0x00, 0x78, 0x00, 0x00, 0x38, 0x00, 0x00, 0x38, 0x1c, 
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	0x00, 0x00, 0x00, 0x01, 0xff, 0x80, 0x00, 0x00
	},
	{
		// 'dvd2' 60x60px

	0x00, 0x00, 0x01, 0xff, 0x80, 0x00, 0x00, 0x00, 0x00, 0x1f, 0xff, 0xf8, 0x00, 0x00, 0x00, 0x00, 
	0x7e, 0x00, 0x7e, 0x00, 0x00, 0x00, 0x03, 0xe0, 0x00, 0x07, 0xc0, 0x00, 0x00, 0x07, 0x80, 0x00, 
	0x01, 0xe0, 0x00, 0x00, 0x1e, 0x00, 0x00, 0x00, 0x78, 0x00, 0x00, 0x38, 0x00, 0x00, 0x00, 0x1c, 
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	0x00, 0x00, 0x00, 0x01, 0xff, 0x80, 0x00, 0x00
	},
	{
		// 'dvd3' 60x60px

	0x00, 0x00, 0x01, 0xff, 0x80, 0x00, 0x00, 0x00, 0x00, 0x1f, 0xff, 0xf8, 0x00, 0x00, 0x00, 0x00, 
	0x7e, 0x00, 0x7e, 0x00, 0x00, 0x00, 0x03, 0xe0, 0x00, 0x07, 0xc0, 0x00, 0x00, 0x07, 0x80, 0x00, 
	0x01, 0xe0, 0x00, 0x00, 0x1e, 0x00, 0x00, 0x00, 0x78, 0x00, 0x00, 0x38, 0x00, 0x00, 0x00, 0x1c, 
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	0x00, 0x00, 0x00, 0x01, 0xff, 0x80, 0x00, 0x00
	},
	{
		// 'dvd4' 60x60px

	0x00, 0x00, 0x01, 0xff, 0x80, 0x00, 0x00, 0x00, 0x00, 0x1f, 0xff, 0xf8, 0x00, 0x00, 0x00, 0x00, 
	0x7e, 0x00, 0x7e, 0x00, 0x00, 0x00, 0x03, 0xe0, 0x00, 0x07, 0xc0, 0x00, 0x00, 0x07, 0x80, 0x00, 
	0x01, 0xe0, 0x00, 0x00, 0x1e, 0x00, 0x00, 0x00, 0x78, 0x00, 0x00, 0x38, 0x00, 0x00, 0x00, 0x1c, 
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	0x00, 0x00, 0x00, 0x01, 0xff, 0x80, 0x00, 0x00
	},
  	{
		// 'dvd1' 60x60px

	0x00, 0x00, 0x01, 0xff, 0x80, 0x00, 0x00, 0x00, 0x00, 0x1f, 0xff, 0xf8, 0x00, 0x00, 0x00, 0x00, 
	0x7e, 0x00, 0x7e, 0x00, 0x00, 0x00, 0x03, 0xe0, 0x00, 0x07, 0xc0, 0x00, 0x00, 0x07, 0x80, 0x00, 
	0x01, 0xe0, 0x00, 0x00, 0x1e, 0x00, 0x00, 0x00, 0x78, 0x00, 0x00, 0x38, 0x00, 0x00, 0x38, 0x1c, 
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	0x00, 0x00, 0x00, 0x01, 0xff, 0x80, 0x00, 0x00
	},
	{
		// 'dvd2' 60x60px

	0x00, 0x00, 0x01, 0xff, 0x80, 0x00, 0x00, 0x00, 0x00, 0x1f, 0xff, 0xf8, 0x00, 0x00, 0x00, 0x00, 
	0x7e, 0x00, 0x7e, 0x00, 0x00, 0x00, 0x03, 0xe0, 0x00, 0x07, 0xc0, 0x00, 0x00, 0x07, 0x80, 0x00, 
	0x01, 0xe0, 0x00, 0x00, 0x1e, 0x00, 0x00, 0x00, 0x78, 0x00, 0x00, 0x38, 0x00, 0x00, 0x00, 0x1c, 
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	0x00, 0x00, 0x00, 0x01, 0xff, 0x80, 0x00, 0x00
	},
	{
		// 'dvd3' 60x60px

	0x00, 0x00, 0x01, 0xff, 0x80, 0x00, 0x00, 0x00, 0x00, 0x1f, 0xff, 0xf8, 0x00, 0x00, 0x00, 0x00, 
	0x7e, 0x00, 0x7e, 0x00, 0x00, 0x00, 0x03, 0xe0, 0x00, 0x07, 0xc0, 0x00, 0x00, 0x07, 0x80, 0x00, 
	0x01, 0xe0, 0x00, 0x00, 0x1e, 0x00, 0x00, 0x00, 0x78, 0x00, 0x00, 0x38, 0x00, 0x00, 0x00, 0x1c, 
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	0x00, 0x00, 0x00, 0x01, 0xff, 0x80, 0x00, 0x00
	},
	{
	//	'dvd4' 60x60px

	0x00, 0x00, 0x01, 0xff, 0x80, 0x00, 0x00, 0x00, 0x00, 0x1f, 0xff, 0xf8, 0x00, 0x00, 0x00, 0x00, 
	0x7e, 0x00, 0x7e, 0x00, 0x00, 0x00, 0x03, 0xe0, 0x00, 0x07, 0xc0, 0x00, 0x00, 0x07, 0x80, 0x00, 
	0x01, 0xe0, 0x00, 0x00, 0x1e, 0x00, 0x00, 0x00, 0x78, 0x00, 0x00, 0x38, 0x00, 0x00, 0x00, 0x1c, 
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	0x00, 0x00, 0x00, 0x01, 0xff, 0x80, 0x00, 0x00
	}
};

bool isPlaying = false;
int cursorPosition = 0;
bool updateScreen = false;
int musicIndex = 0;
bool check = false;
SSD1306_t dev;
uint8_t *segmentImage = (uint8_t *)malloc(IMAGES*8*56); // 4 IMAGES 8 page 56 pixel
string listMusic[10];
// biến lưu chỉ số mảng chứa tên file nhạc
int i = 0;

// hàm gán tên file vào mảng để xử lí
void list_files(const char *path) {
    printf("Listing files in %s:\n", path);

    // Open directory
    DIR *dir = opendir(path);
    if (!dir) {
        ESP_LOGE(TAG, "Failed to open directory");
        return;
    }

    // Read directory entries
    struct dirent *entry;
    while ((entry = readdir(dir)) != NULL) {
		if((string)entry->d_name == "SYSTEM~1" ) {
			continue;
		}
		listMusic[i] =  (string)entry->d_name;
		cout<<"vcc"<<listMusic[i]<<endl;
		i++;
    }

    // Close directory
    closedir(dir);
	check = true;
}

void wait_for_button_push()
{
  while (isPlaying == false)
  {
    vTaskDelay(pdMS_TO_TICKS(100));
  }
}
void  wait_for_check() {
	while (check== false)
	{
    vTaskDelay(pdMS_TO_TICKS(10));
	}
	
}

void wait_for_var()
{
  while (updateScreen == false)
  {
	// name1 = ;
    vTaskDelay(pdMS_TO_TICKS(100));
	
  }
}
const int BUFFER_SIZE = 1024;
int segmentImageIndexplus = 8*56;

// hàm hiển thị thanh công cụ
void displaytoolbar(SSD1306_t* dev ) {

	wait_for_check();
	ssd1306_clear_screen(dev, false);
	for (int page=0;page<8;page++) {
		ssd1306_display_image(dev, page, 0, &segmentImage[segmentImageIndexplus+page*56], 56);
	}
	// thêm phần cách cho tên file để hiển thị đúng vị trí cần trên oled và chuyển sang kiểu 
	// const char để hiển thị
		string space = "         ";
		space += listMusic[musicIndex];
		const char* charlistMusic = space.c_str();

	if(isPlaying) {
		if(cursorPosition == 0) {
		ssd1306_display_text(dev, 0,(char*) charlistMusic, 20, false);
		ssd1306_bitmaps(dev, 70, 35, prev_icon, 16, 16, true);
		ssd1306_bitmaps(dev, 90, 35, pause_icon, 16, 16, false);
		ssd1306_bitmaps(dev, 110, 35, next_icon, 16, 16, false);
		
		}
		if(cursorPosition == 1) {
		ssd1306_display_text(dev, 0,(char*) charlistMusic, 20, false);
		ssd1306_bitmaps(dev, 70, 35, prev_icon, 16, 16, false);
		ssd1306_bitmaps(dev, 90, 35, pause_icon, 16, 16, true);
		ssd1306_bitmaps(dev, 110, 35, next_icon, 16, 16, false);
		
		}

		if(cursorPosition == 2) {
		ssd1306_display_text(dev, 0,(char*) charlistMusic, 20, false);
		ssd1306_bitmaps(dev, 70, 35, prev_icon, 16, 16, false);
		ssd1306_bitmaps(dev, 90, 35, pause_icon, 16, 16, false);
		ssd1306_bitmaps(dev, 110, 35, next_icon, 16, 16, true);
		
		}
	} else {
		if(cursorPosition == 0) {
		ssd1306_display_text(dev, 0,(char*) charlistMusic, 20, false);
		ssd1306_bitmaps(dev, 70, 35, prev_icon, 16, 16, true);
		ssd1306_bitmaps(dev, 90, 35, play_icon, 16, 16, false);
		ssd1306_bitmaps(dev, 110, 35, next_icon, 16, 16, false);
		
		}
		if(cursorPosition == 1) {
		ssd1306_display_text(dev, 0,(char*) charlistMusic, 20, false);
		ssd1306_bitmaps(dev, 70, 35, prev_icon, 16, 16, false);
		ssd1306_bitmaps(dev, 90, 35, play_icon, 16, 16, true);
		ssd1306_bitmaps(dev, 110, 35, next_icon, 16, 16, false);
		
		}

		if(cursorPosition == 2) {
		ssd1306_display_text(dev, 0,(char*) charlistMusic, 20, false);
		ssd1306_bitmaps(dev, 70, 35, prev_icon, 16, 16, false);
		ssd1306_bitmaps(dev, 90, 35, play_icon, 16, 16, false);
		ssd1306_bitmaps(dev, 110, 35, next_icon, 16, 16, true);
		
		}
	}
	
	updateScreen =  false;
}

// task chơi nhạc
void play_task(void *param)
{
		wait_for_check();

#ifdef VOLUME_CONTROL
  // set up the ADC for reading the volume control
  adc1_config_width(ADC_WIDTH_BIT_12);
  adc1_config_channel_atten(ADC1_CHANNEL_7, ADC_ATTEN_DB_11);
#endif
  // create the output - see config.h for settings
#ifdef USE_I2S
  Output *output = new I2SOutput(I2S_NUM_0, i2s_speaker_pins);
#else
  Output *output = new DACOutput();
// #endif
#ifdef I2S_SPEAKDER_SD_PIN
  // if you I2S amp has a SD pin, you'll need to turn it on
  gpio_set_direction(I2S_SPEAKDER_SD_PIN, GPIO_MODE_OUTPUT);
  gpio_set_level(I2S_SPEAKDER_SD_PIN, 1);
#endif

  short *pcm = (short *)malloc(sizeof(short) * MINIMP3_MAX_SAMPLES_PER_FRAME);
  uint8_t *input_buf = (uint8_t *)malloc(BUFFER_SIZE);
  if (!pcm)
  {
    ESP_LOGE("main", "Failed to allocate pcm memory");
  }
  if (!input_buf)
  {
    ESP_LOGE("main", "Failed to allocate input_buf memory");
  }
  // int i = 1;
 
  while (1)
  {
    // wait for the button to be pushed
    wait_for_button_push();
    // mp3 decoder state
    mp3dec_t mp3d = {};
    mp3dec_init(&mp3d);
    mp3dec_frame_info_t info = {};
    // keep track of how much data we have buffered, need to read and decoded
    int to_read = BUFFER_SIZE;
    int buffered = 0;
    int decoded = 0;
    bool is_output_started = false;

	string line = "/sdcard/";
	line += listMusic[musicIndex];
	const char* charpathMusic = line.c_str();
    FILE *fp = fopen(charpathMusic, "r");

    if (!fp)
    {
      ESP_LOGE("main", "Failed to open file");
      continue;
    }
    while (1)
    {
		static int last_index;
		int index;
		index = musicIndex;
    wait_for_button_push();
	if(index != musicIndex) {
		 output->stop();
        is_output_started = false;
        break;
	}
#ifdef VOLUME_CONTROL
      auto adc_value = float(adc1_get_raw(VOLUME_CONTROL)) / 4096.0f;
      // make the actual volume match how people hear
      // https://ux.stackexchange.com/questions/79672/why-dont-commercial-products-use-logarithmic-volume-controls
      output->set_volume(adc_value * adc_value);
#endif
      // read in the data that is needed to top up the buffer
      size_t n = fread(input_buf + buffered, 1, to_read, fp);
      // feed the watchdog
      vTaskDelay(pdMS_TO_TICKS(1));

      buffered += n;
      if (buffered == 0)
      {
        // we've reached the end of the file and processed all the buffered data
        output->stop();
        is_output_started = false;
        break;
      }
      // decode the next frame
      int samples = mp3dec_decode_frame(&mp3d, input_buf, buffered, pcm, &info);
      // we've processed this may bytes from teh buffered data
      buffered -= info.frame_bytes;
      // shift the remaining data to the front of the buffer
      memmove(input_buf, input_buf + info.frame_bytes, buffered);
      // we need to top up the buffer from the file
      to_read = info.frame_bytes;
      if (samples > 0)
      {
        // if we haven't started the output yet we can do it now as we now know the sample rate and number of channels
        if (!is_output_started)
        {
          output->start(info.hz);
          is_output_started = true;
        }
        // if we've decoded a frame of mono samples convert it to stereo by duplicating the left channel
        // we can do this in place as our samples buffer has enough space
        if (info.channels == 1)
        {
          for (int i = samples - 1; i >= 0; i--)
          {
            pcm[i * 2] = pcm[i];
            pcm[i * 2 - 1] = pcm[i];
          }
        }
        // write the decoded samples to the I2S output
        output->write(pcm, samples);
        // keep track of how many samples we've decoded
        decoded += samples;
      }

	  last_index = index;
    }
    ESP_LOGI("main", "Finished\n");
    fclose(fp);
    
  }
  
}
// undisplay bitmap
void ssd1306_bitmaps_convert(SSD1306_t * dev, int xpos, int ypos, uint8_t * bitmap, int width, int height, bool invert)
{
	if ( (width % 8) != 0) {
		ESP_LOGE(TAG, "width must be a multiple of 8");
		return;
	}
	int _width = width / 8;
	uint8_t wk0;
	uint8_t wk1;
	uint8_t wk2;
	uint8_t page = (ypos / 8);
	uint8_t _seg = xpos;
	uint8_t dstBits = (ypos % 8);
	ESP_LOGD(TAG, "ypos=%d page=%d dstBits=%d", ypos, page, dstBits);
	int offset = 0;
	for(int _height=0;_height<height;_height++) {
		for (int index=0;index<_width;index++) {
			for (int srcBits=7; srcBits>=0; srcBits--) {
				wk0 = dev->_page[page]._segs[_seg];
				if (dev->_flip) wk0 = ssd1306_rotate_byte(wk0);

				wk1 = bitmap[index+offset];
				if (invert) wk1 = ~wk1;

				//wk2 = ssd1306_copy_bit(bitmap[index+offset], srcBits, wk0, dstBits);
				wk2 = ssd1306_copy_bit(wk1, srcBits, wk0, dstBits);
				if (dev->_flip) wk2 = ssd1306_rotate_byte(wk2);

				ESP_LOGD(TAG, "index=%d offset=%d page=%d _seg=%d, wk2=%02x", index, offset, page, _seg, wk2);
				dev->_page[page]._segs[_seg] = wk2;
				_seg++;
			}
		}
		vTaskDelay(1);
		offset = offset + _width;
		dstBits++;
		_seg = xpos;
		if (dstBits == 8) {
			page++;
			dstBits=0;
		}
	}

#if 0
	for (int _seg=ypos;_seg<ypos+width;_seg++) {
		ssd1306_dump_page(dev, page-1, _seg);
	}
	for (int _seg=ypos;_seg<ypos+width;_seg++) {
		ssd1306_dump_page(dev, page, _seg);
	}
#endif
	
}

// task hiển thị oled
void display_task(void *param) {
	
	#if CONFIG_I2C_INTERFACE
		ESP_LOGI(TAG, "INTERFACE is i2c");
		ESP_LOGI(TAG, "CONFIG_SDA_GPIO=%d",CONFIG_SDA_GPIO);
		ESP_LOGI(TAG, "CONFIG_SCL_GPIO=%d",CONFIG_SCL_GPIO);
		ESP_LOGI(TAG, "CONFIG_RESET_GPIO=%d",CONFIG_RESET_GPIO);
		i2c_master_init(&dev, CONFIG_SDA_GPIO, CONFIG_SCL_GPIO, CONFIG_RESET_GPIO);
	#endif // CONFIG_I2C_INTERFACE

	#if CONFIG_SSD1306_128x64
		ESP_LOGI(TAG, "Panel is 128x64");
		ssd1306_init(&dev, 128, 64);
	#endif // CONFIG_SSD1306_128x64
	#if CONFIG_SSD1306_128x32
		ESP_LOGE(TAG, "Panel is 128x32. This demo cannot be run.");
		while(1) { vTaskDelay(1); }
	#endif // CONFIG_SSD1306_128x32
	ssd1306_contrast(&dev, 0xff);

	// Allocate memory
	uint8_t *buffer = (uint8_t *)malloc(8*128); // 4 page 112 pixel
	if (buffer == NULL) {
		ESP_LOGE(TAG, "malloc failed");
		while(1) { vTaskDelay(1); }
	}
	if (segmentImage == NULL) {
		ESP_LOGE(TAG, "malloc failed");
		while(1) { vTaskDelay(1); }
	}

	// Convert from segmentDisplay to segmentImage
	for (int imageIndex=0; imageIndex<IMAGES; imageIndex++) {
		ssd1306_clear_screen(&dev, false);
		ssd1306_bitmaps_convert(&dev, 0, 8, dvd_icon[imageIndex], 56, 56, false);
		ssd1306_get_buffer(&dev, buffer);
		int segmentImageIndex = imageIndex * 8 * 56;
		for (int page=0;page<8;page++) {
			memcpy(&segmentImage[segmentImageIndex+page*56], &buffer[page*128], 56);
			ESP_LOGE(TAG, "11111");
		}

	}

	displaytoolbar(&dev);

		while (1)
	{	
		// kiểm tra trạng thái biến true thì sẽ chạy ảnh đĩa 
		wait_for_button_push();
			
				vTaskDelay(1);
				for (int imageIndex=0;imageIndex<IMAGES; imageIndex++) {
					int segmentImageIndex = imageIndex * 8 * 56;

					for (int page=0;page<8;page++) {
					ssd1306_display_image(&dev, page, 0, &segmentImage[segmentImageIndex+page*56], 56);
					}
					vTaskDelay(10);

				}
	}
	xTaskNotifyGive(NULL);
}

// task update màn oled
void update_task(void *param) {

	while (1) {
		wait_for_var();
		vTaskDelay(1);
		displaytoolbar(&dev);
	}
		xTaskNotifyGive(NULL);
}

// hàm xử lí ngắt
void input_event_callback(int pin) {
	static uint64_t last_interrupt_time = 0;
	uint64_t interrupt_time = esp_timer_get_time() / 1000; 
	if(interrupt_time - last_interrupt_time > 150) {
		if(pin == GPIO_NUM_5) {
			if(cursorPosition == 1) {
				isPlaying = !isPlaying;
			}
			if(cursorPosition == 0) {
				musicIndex--;
				if(musicIndex<0) {
					musicIndex = i-1;
				}

			}
			if(cursorPosition == 2) {
				musicIndex++;
				if(musicIndex>i-1) {
					musicIndex = 0;
				}
			}
		}
		if(pin == GPIO_NUM_4) {
			cursorPosition++;
			if(cursorPosition > 2) {
				cursorPosition = 0;
			}
		}
			if(pin == GPIO_NUM_18) {
			cursorPosition--;
			if(cursorPosition <0 ) {
				cursorPosition = 2;
			}
		}
		updateScreen = true;
	}
	last_interrupt_time = interrupt_time; 

}

void app_main(void)
{

	esp_timer_handle_t timer = NULL;

    // Khởi tạo hàm đo thời gian
    esp_timer_create_args_t timer_conf = {
        .callback = NULL,
        .name = "my_timer"
    };
    esp_timer_create(&timer_conf, &timer);

	input_io_create(GPIO_NUM_5, HI_TO_LO);
	input_io_create(GPIO_NUM_18, HI_TO_LO);
	input_io_create(GPIO_NUM_4, HI_TO_LO);
    input_set_callback(input_event_callback);

#if 0
#if CONFIG_FLIP
	dev._flip = true;
	ESP_LOGW(TAG, "Flip upside down");
#endif
#endif

	//CONFIG CHO SDCARD
	esp_err_t ret;
    // Options for mounting the filesystem.
    // If format_if_mount_failed is set to true, SD card will be partitioned and
    // formatted in case when mounting fails.
    esp_vfs_fat_sdmmc_mount_config_t mount_config = {
#ifdef CONFIG_EXAMPLE_FORMAT_IF_MOUNT_FAILED
        .format_if_mount_failed = true,
#else
        .format_if_mount_failed = false,
#endif // EXAMPLE_FORMAT_IF_MOUNT_FAILED
        .max_files = 5,
        .allocation_unit_size = 16 * 1024
    };
    sdmmc_card_t *card;
    
    const char mount_point[] = MOUNT_POINT;
    ESP_LOGI(TAG, "Initializing SD card");

    // Use settings defined above to initialize SD card and mount FAT filesystem.
    // Note: esp_vfs_fat_sdmmc/sdspi_mount is all-in-one convenience functions.
    // Please check its source code and implement error recovery when developing
    // production applications.
#ifndef USE_SPI_MODE
    ESP_LOGI(TAG, "Using SDMMC peripheral");
    sdmmc_host_t host = SDMMC_HOST_DEFAULT();
    // This initializes the slot without card detect (CD) and write protect (WP) signals.
    // Modify slot_config.gpio_cd and slot_config.gpio_wp if your board has these signals.
    sdmmc_slot_config_t slot_config = SDMMC_SLOT_CONFIG_DEFAULT();

    // To use 1-line SD mode, uncomment the following line:
    // slot_config.width = 1;

    // GPIOs 15, 2, 4, 12, 13 should have external 10k pull-ups.
    // Internal pull-ups are not sufficient. However, enabling internal pull-ups
    // does make a difference some boards, so we do that here.
    gpio_set_pull_mode(15, GPIO_PULLUP_ONLY);   // CMD, needed in 4- and 1- line modes
    gpio_set_pull_mode(2, GPIO_PULLUP_ONLY);    // D0, needed in 4- and 1-line modes
    gpio_set_pull_mode(4, GPIO_PULLUP_ONLY);    // D1, needed in 4-line mode only
    gpio_set_pull_mode(12, GPIO_PULLUP_ONLY);   // D2, needed in 4-line mode only
    gpio_set_pull_mode(13, GPIO_PULLUP_ONLY);   // D3, needed in 4- and 1-line modes

    ESP_LOGI(TAG, "Mounting filesystem");
    ret = esp_vfs_fat_sdmmc_mount(mount_point, &host, &slot_config, &mount_config, &card);
#else
    ESP_LOGI(TAG, "Using SPI peripheral");

    sdmmc_host_t host = SDSPI_HOST_DEFAULT();
     host.max_freq_khz = 5000;

    spi_bus_config_t bus_cfg = {
        .mosi_io_num = PIN_NUM_MOSI,
        .miso_io_num = PIN_NUM_MISO,
        .sclk_io_num = PIN_NUM_CLK,
        .quadwp_io_num = -1,
        .quadhd_io_num = -1,
        .max_transfer_sz = 4000,
    };
    ret = spi_bus_initialize((spi_host_device_t)host.slot, &bus_cfg, SPI_DMA_CHAN);
    if (ret != ESP_OK) {
        ESP_LOGE(TAG, "Failed to initialize bus.");
        return;
    }

    // This initializes the slot without card detect (CD) and write protect (WP) signals.
    // Modify slot_config.gpio_cd and slot_config.gpio_wp if your board has these signals.
    sdspi_device_config_t slot_config = SDSPI_DEVICE_CONFIG_DEFAULT();
    slot_config.gpio_cs = PIN_NUM_CS;
    slot_config.host_id =(spi_host_device_t) host.slot;

    ret = esp_vfs_fat_sdspi_mount(mount_point, &host, &slot_config, &mount_config, &card);
#endif //USE_SPI_MODE

    if (ret != ESP_OK) {
        if (ret == ESP_FAIL) {
            ESP_LOGE(TAG, "Failed to mount filesystem. "
                     "If you want the card to be formatted, set the EXAMPLE_FORMAT_IF_MOUNT_FAILED menuconfig option.");
        } else {
            ESP_LOGE(TAG, "Failed to initialize the card (%s). "
                     "Make sure SD card lines have pull-up resistors in place.", esp_err_to_name(ret));
        }
        return;
    }
    ESP_LOGI(TAG, "Filesystem mounted");

    // Card has been initialized, print its properties
    sdmmc_card_print_info(stdout, card);

    // Use POSIX and C standard library functions to work with files.
    // First create a file.
    list_files(MOUNT_POINT);

// chạy các task hiển thị đĩa dvd, cập nhật màn hình, chơi nhạc
  xTaskCreate(display_task, "taskdisplay", 10000, NULL, 5, NULL);
  xTaskCreate(update_task, "taskupdate", 5000, NULL, 4, NULL);
  xTaskCreate(play_task, "task", 32768, NULL, 6, NULL);
	
}















